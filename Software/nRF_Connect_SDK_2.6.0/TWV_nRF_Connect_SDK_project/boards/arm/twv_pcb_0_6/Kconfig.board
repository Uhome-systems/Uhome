## Software/nRF_Connect_SDK_2.6.0/TWV_nRF_Connect_SDK_project/boards/arm/twv_pcb_0_6/Kconfig.board
```kconfig
# TWV_PCB_0_6 board configuration

# Copyright (c) 2016 Nordic Semiconductor ASA
# SPDX-License-Identifier: Apache-2.0

config BOARD_TWV_PCB_0_6
	bool "TWV PCB"
	depends on SOC_NRF52840_QIAA
```

## Software/nRF_Connect_SDK_2.6.0/TWV_nRF_Connect_SDK_project/boards/arm/twv_pcb_0_6/Kconfig.defconfig
```kconfig
# TWV_PCB_0_6 board configuration

# Copyright (c) 2016 Nordic Semiconductor ASA
# SPDX-License-Identifier: Apache-2.0

if BOARD_TWV_PCB_0_6

config BOARD
	default "twv_pcb_0_6"

config BT_CTLR
	default BT

endif # BOARD_TWV_PCB_0_6
```
